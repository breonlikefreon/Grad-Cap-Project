#include <RGBmatrixPanel.h>


#include <Adafruit_GFX.h>
#include <Adafruit_NeoMatrix.h>
#include <Adafruit_NeoPixel.h>
#ifndef PSTR
#define PSTR // Make Arduino Due happy
#endif

#define CLK 11 // USE THIS ON ARDUINO MEGA
#define OE   9
#define LAT 10
#define A   A0
#define B   A1
#define C   A2
#define D   A3

RGBmatrixPanel matrix(A, B, C, D, CLK, LAT, OE, false);

const unsigned short elogo[1024] PROGMEM = {
  0xFFFF, 0xFFFF, 0xFFFF, 0xFFFF, 0xFFFF, 0xFFFF, 0xFFFF, 0xFFFF, 0xFFFF, 0xFFFF, 0xFFFF, 0xFFFF, 0xFFFF, 0xFFFF, 0xFFFF, 0xFFFF,   // 0x0010 (16) pixels
  0xFFFF, 0xFFFF, 0xFFFF, 0xFFFF, 0xFFFF, 0xFFFF, 0xFFFF, 0xFFFF, 0xFFFF, 0xFFFF, 0xFFFF, 0xFFFF, 0xFFFF, 0xFFFF, 0xFFFF, 0xFFFF,   // 0x0020 (32) pixels
  0xFFFF, 0xFFFF, 0xFFFF, 0xFFFF, 0xFFFF, 0xFFFF, 0xFFFF, 0xFFFF, 0xFFFF, 0xFFFF, 0xFFFF, 0xFFFF, 0xFFFF, 0xFFFF, 0xFFFF, 0xFFFF,   // 0x0030 (48) pixels
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  0xFFFF, 0xFFFF, 0xFFFF, 0xFFFF, 0xFFFF, 0xFFFF, 0xFFFF, 0xFFFF, 0xFFFF, 0xFFFF, 0xFFFF, 0xFFFF, 0xFFFF, 0xFFFF, 0xFFFF, 0xFFFF,   // 0x0400 (1024) pixels
};


const unsigned short blm[1024] PROGMEM = {
0x0000, 0x0000, 0x0000, 0x0000, 0x0000, 0x0000, 0x0000, 0x0000, 0x0000, 0x0000, 0x0000, 0x0000, 0x0000, 0x0000, 0x0000, 0x0000,   // 0x0010 (16) pixels
0x0000, 0x0000, 0x0000, 0x0000, 0x0000, 0x0000, 0x0000, 0x0000, 0x0000, 0x0000, 0x0000, 0x0000, 0x0000, 0x0000, 0x0000, 0x0000,   // 0x0020 (32) pixels
0x0000, 0x0000, 0x0000, 0x0000, 0x0000, 0x0000, 0x0000, 0x0000, 0x0000, 0x0000, 0x0000, 0x0000, 0x0000, 0x0000, 0x0000, 0x0000,   // 0x0030 (48) pixels
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0x0000, 0x0000, 0x0000, 0x0000, 0x0000, 0x0000, 0x0000, 0x0000, 0x0000, 0x0000, 0x0000, 0x0000, 0x0000, 0x0000, 0x0000, 0x0000,   // 0x0400 (1024) pixels
};



void setup() {
  // put your setup code here, to run once:
  matrix.begin();
  matrix.fillScreen(matrix.Color333(0, 0, 0));
  matrix.setTextWrap(false); // Don't wrap at end of line - will do ourselves
 
}
int y = 0;
int x    = matrix.width();
int pass = 0;

void firstext(int x, int pass)
{
  matrix.setTextSize(2);

  matrix.fillScreen(0);
  matrix.setTextColor(matrix.Color333(7, 0, 4));
  matrix.setCursor(x, 9);
  matrix.print(F("Breon Anderson Electrical Engineering"));
  if (--x < -500) {
    x = matrix.width();
    if (++pass >= 10) pass = 4;
    //   matrix.setTextColor(colors[pass]);
  }
  delay(5);
}


void loop() {
 matrix.setTextSize(2);
  int y = 0;
delay(4000);
  while (y < 1) {
y=0;
    matrix.fillScreen(0);
    matrix.setTextColor(matrix.Color333(2, 5, 4));
    matrix.setCursor(x, 9);
    matrix.print(F("I Love you Mom and Dad "));
    if (--x < -300) {
      x = matrix.width();
      y++;
      //if (++pass >= 10) pass = 4;
      //   matrix.setTextColor(colors[pass]);
    }
    delay(40);

  }
  matrix.drawRGBBitmap(0, 0, (const uint16_t *)blm, 32, 32);
  delay(4000);
  matrix.fillScreen(0);



  for (y = 0; y < 230; y = y + 1) {

    matrix.fillScreen(0);
    matrix.setTextColor(matrix.Color333(6, 5, 4));
    matrix.setCursor(x, 9);
    matrix.print(F("I Love you Brandi "));
    if (--x < -250) {
      x = matrix.width();

      //if (++pass >= 10) pass = 4;
      //   matrix.setTextColor(colors[pass]);
    }
    delay(40);
  }

  matrix.drawRGBBitmap(0, 0, (const uint16_t *)elogo, 32, 32);
  delay(4000);
  matrix.fillScreen(0);
  y=0;








}
